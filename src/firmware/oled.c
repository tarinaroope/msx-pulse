/* The mock header must precede any header that transitively includes
 * ipc.h — ipc.h's NATIVE_TEST fallback checks for PICO_STDLIB_MOCK_H
 * (set by the mock) and silently skips its own spin_lock stubs. */
#ifndef NATIVE_TEST
#include "hardware/i2c.h"
#include "hardware/gpio.h"
#include "pico/stdlib.h"
#else
#include "pico_stdlib_mock.h"
#endif

#include "oled.h"
#include "oled_internal.h"
#include "ui.h"
#include <string.h>
#include <stdio.h>

/* OLED_STATIC is `static` in the firmware build, empty under NATIVE_TEST so
 * test_oled.c can reach the framebuffer and the helpers declared in
 * oled_internal.h. Defined here only, not leaked. */
#ifdef NATIVE_TEST
#define OLED_STATIC
#else
#define OLED_STATIC static
#endif

#define GP_SDA      36
#define GP_SCL      37

OLED_STATIC uint8_t  oled_addr;
OLED_STATIC bool     oled_present;
static volatile display_state_t display_state = DISP_BOOT;


OLED_STATIC uint8_t  fb[OLED_PAGES][OLED_W];

/* 5×7 font, public domain, column-major, bit 0 = top. 96 glyphs, ASCII
 * 0x20 (' ') to 0x7F (DEL). */
static const uint8_t font5x7[96][5] = {
    {0x00,0x00,0x00,0x00,0x00}, /* 0x20   */
    {0x00,0x00,0x5F,0x00,0x00}, /* 0x21 ! */
    {0x00,0x07,0x00,0x07,0x00}, /* 0x22 " */
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    {0x08,0x1C,0x2A,0x08,0x08}, /* 0x7F DEL */
};

#ifndef NATIVE_TEST

/* Send up to 22 command bytes in one I2C transaction. Control byte 0x00 marks
 * the payload as a command stream. */
static void oled_cmdn(const uint8_t *cmds, int n) {
    uint8_t buf[32];
    if (n > (int)(sizeof(buf) - 1)) return;
    buf[0] = 0x00;
    memcpy(buf + 1, cmds, (size_t)n);
    i2c_write_blocking(i2c0, oled_addr, buf, (size_t)(n + 1), false);
}

static void oled_flush(void) {
    /* Horizontal addressing, window = full display. */
    static const uint8_t addr_setup[] = { 0x21, 0, 127, 0x22, 0, 7 };
    oled_cmdn(addr_setup, sizeof(addr_setup));

    /* One data burst per page: [0x40, 128 bytes]. */
    uint8_t buf[OLED_W + 1];
    buf[0] = 0x40;
    for (int pg = 0; pg < OLED_PAGES; pg++) {
        memcpy(buf + 1, fb[pg], OLED_W);
        i2c_write_blocking(i2c0, oled_addr, buf, sizeof(buf), false);
    }
}

static void oled_ssd1306_init(void) {
    static const uint8_t seq[] = {
        0xAE,        /* display off                          */
        0xD5, 0x80,  /* clock divide ratio / oscillator freq */
        0xA8, 0x3F,  /* multiplex ratio: 64 rows - 1         */
        0xD3, 0x00,  /* display offset: 0                    */
        0x40,        /* display start line: 0                */
        0x8D, 0x14,  /* charge pump: enable                  */
        0x20, 0x00,  /* memory addressing: horizontal        */
        0xA1,        /* segment re-map (column 127 = SEG0)   */
        0xC8,        /* COM scan: remapped (top → bottom)    */
        0xDA, 0x12,  /* COM pins HW config: alt, no remap    */
        0x81, 0xCF,  /* contrast: 0xCF                       */
        0xD9, 0xF1,  /* pre-charge period                    */
        0xDB, 0x40,  /* VCOMH deselect level                 */
        0xA4,        /* output follows RAM (not all-on)      */
        0xA6,        /* normal polarity (not inverted)       */
        0xAF,        /* display on                           */
    };
    oled_cmdn(seq, sizeof(seq));
}

#else /* NATIVE_TEST: only oled_flush is reached via oled_refresh(). */

static void oled_flush(void) { /* no-op */ }

#endif

const uint8_t hb_full[5]   = { 0x1C, 0x3E, 0x3E, 0x3E, 0x1C };
const uint8_t hb_hollow[5] = { 0x1C, 0x22, 0x22, 0x22, 0x1C };

void fb_clear(void) {
    memset(fb, 0, sizeof(fb));
}

void fb_putchar(int page, int x, char c) {
    if (page < 0 || page >= OLED_PAGES) return;
    if (x < 0 || x + 5 > OLED_W) return;
    if ((unsigned char)c < 0x20 || (unsigned char)c > 0x7F) c = '?';
    const uint8_t *g = font5x7[(uint8_t)c - 0x20];
    for (int col = 0; col < 5; col++) fb[page][x + col] = g[col];
    if (x + 5 < OLED_W) fb[page][x + 5] = 0;  /* 1 px gap */
}

void fb_putglyph(int page, int x, const uint8_t glyph[5]) {
    if (page < 0 || page >= OLED_PAGES) return;
    if (x < 0 || x + 5 > OLED_W) return;
    for (int col = 0; col < 5; col++) fb[page][x + col] = glyph[col];
    if (x + 5 < OLED_W) fb[page][x + 5] = 0;  /* 1 px gap */
}

void fb_puts(int page, int x, const char *s) {
    while (*s && x + CHAR_W <= OLED_W) {
        fb_putchar(page, x, *s++);
        x += CHAR_W;
    }
}

void fb_puts_centered(int page, const char *s) {
    int len = (int)strlen(s);
    int x   = (OLED_W - len * CHAR_W) / 2;
    fb_puts(page, (x < 0 ? 0 : x), s);
}

/* Draw a thin horizontal rule (one pixel row) across a page. */
void fb_hline(int page) {
    memset(fb[page], 0x08, OLED_W);  /* bit 3 = pixel row 3 of the page */
}

OLED_STATIC const char *status_tag(uint8_t s) {
    switch (s) {
        case 0:  return "OK  ";
        case 1:  return "WARN";
        case 2:  return "FAIL";
        default: return "n/c ";
    }
}

OLED_STATIC void render_boot(void) {
    fb_puts_centered(2, "MSXDOC v0.1");
    fb_puts_centered(4, "Initialising...");
}

OLED_STATIC void render_firmware_update(void) {
    fb_puts_centered(2, "FIRMWARE UPDATE");
    fb_hline(3);
    fb_puts_centered(5, "USB BOOTLOADER");
}

bool oled_init(void) {
#ifndef NATIVE_TEST
    i2c_init(i2c0, 400000);
    gpio_set_function(GP_SDA, GPIO_FUNC_I2C);
    gpio_set_function(GP_SCL, GPIO_FUNC_I2C);
    gpio_pull_up(GP_SDA);
    gpio_pull_up(GP_SCL);

    /* Probe 0x3C then 0x3D, retrying. An SSD1306 module can take ~100 ms
     * after power-on before it ACKs I²C, and on a cold boot the MCU hits
     * oled_init() first; a single-shot probe would then latch
     * oled_present=false for the whole session and leave the display black
     * until a manual reset. 10 tries, 20 ms apart, is ~200 ms worst case,
     * well inside the 5 s watchdog. */
    for (int attempt = 0; attempt < 10; attempt++) {
        for (uint8_t addr = 0x3C; addr <= 0x3D; addr++) {
            uint8_t probe = 0;
            if (i2c_read_blocking(i2c0, addr, &probe, 1, false) == 1) {
                oled_addr    = addr;
                oled_present = true;
                oled_ssd1306_init();
                fb_clear();
                oled_flush();
                return true;
            }
        }
        sleep_ms(20);
    }
    oled_present = false;
    return false;
#else
    /* Native tests: pretend the probe succeeded so render_* run. */
    oled_present = true;
    fb_clear();
    return true;
#endif
}

void oled_set_state(display_state_t state) {
    display_state = state;
}

display_state_t oled_get_state(void) {
    return display_state;
}

bool oled_is_present(void) {
    return oled_present;
}

void oled_refresh(const rail_snapshot_t *rails, const bus_transaction_t *recent,
                  uint8_t n_txns, int scroll_offset, bool trace_paused) {
    if (!oled_present) return;

    (void)recent; (void)n_txns; (void)scroll_offset; (void)trace_paused;

    fb_clear();

    uint32_t now_ms = (uint32_t)to_ms_since_boot(get_absolute_time());

    switch (display_state) {
        case DISP_BOOT:
            render_boot();
            break;
        case DISP_FIRMWARE_UPDATE:
            render_firmware_update();
            break;
        default:
            ui_render(now_ms, rails);
            break;
    }

    oled_flush();
}
